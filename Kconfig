## Kconfig
```kconfig
# Copyright (c) 2022 Space Cubics, LLC.
# SPDX-License-Identifier: Apache-2.0

menu "micro-ROS"

config MICRO_ROS
	bool "micro-ROS for Zephyr"
	select CPP
	select POSIX_API if !ARCH_POSIX
	help
	  micro-ROS for Zephyr

if MICRO_ROS

config APP_LINK_WITH_ROS2
	bool "Link 'app' with micro-ROS"
	default y

rsource "modules/microxrcedds-client/Kconfig"
rsource "modules/rmw_microxrcedds/Kconfig"

endif

endmenu
```

## modules/common_interfaces/Kconfig
```kconfig
# Copyright (c) 2022 Space Cubics, LLC.
# SPDX-License-Identifier: Apache-2.0

config COMMON_INTERFACES
	bool "ROS 2 Common Interface Files"
	help
	  ROS 2 Common Interface Files (.msg and .srv).
```

## modules/micro-cdr/Kconfig
```kconfig
# Copyright (c) 2022 Space Cubics, LLC.
# SPDX-License-Identifier: Apache-2.0

config MICRO_CDR
	bool "eProsima Micro CDR"
	help
	  eProsima Micro CDR is a C library implementing the CDR
	  standard serialization methods. This library is focused on
	  embedded and resource-limited systems.
```

## modules/microxrcedds-client/Kconfig
```kconfig
menu "Micro XRCE-DDS Client"

config ROS2_MICROXRCEDDS_CLIENT
	bool "Micro XRCE-DDS Client"
	default y
	help
	  This option enables the ROS2 Micro XRCE-DDS Client library.

if ROS2_MICROXRCEDDS_CLIENT

config ROS2_MICROXRCEDDS_CLIENT_PROFILE_DISCOVERY
	bool "Enable Discovery Profile"
	help
	  This option enables Discovery Profile.

config ROS2_MICROXRCEDDS_CLIENT_PROFILE_UDP
	bool "Enable UDP Transport"
	help
	  This option enables UDP transport.

config ROS2_MICROXRCEDDS_CLIENT_UDP_TRANSPORT_MTU
	int "MTU for UDP transport"
	depends on ROS2_MICROXRCEDDS_CLIENT_PROFILE_UDP
	default 512
	help
	  This option sets the UDP transport MTU.

config ROS2_MICROXRCEDDS_CLIENT_PROFILE_TCP
	bool "Enable TCP Transport"
	help
	  This option enables UDP transport.

config ROS2_MICROXRCEDDS_CLIENT_TCP_TRANSPORT_MTU
	int "MTU for TCP transport"
	depends on ROS2_MICROXRCEDDS_CLIENT_PROFILE_TCP
	default 512
	help
	  This option sets the TCP transport MTU.

config ROS2_MICROXRCEDDS_CLIENT_PROFILE_CAN
	bool "Enable CAN FD Transport"
	help
	  This option enables CAN transport.

config ROS2_MICROXRCEDDS_CLIENT_PROFILE_SERIAL
	bool "Enable Serial Transport"
	help
	  This option enables Serial transport.

config ROS2_MICROXRCEDDS_CLIENT_SERIAL_TRANSPORT_MTU
	int "MTU for SERIAL transport"
	depends on ROS2_MICROXRCEDDS_CLIENT_PROFILE_SERIAL
	default 512
	help
	  This option sets the seria transport MTU.

config ROS2_MICROXRCEDDS_CLIENT_PROFILE_CUSTOM_TRANSPORT
	bool "Enable Custom Transport"
	default y
	help
	  This option enables Custom Transport.  Currently Zephyr only
	  supports this.

config ROS2_MICROXRCEDDS_CLIENT_CUSTOM_TRANSPORT_MTU
	int "MTU for custom transport"
	depends on ROS2_MICROXRCEDDS_CLIENT_PROFILE_CUSTOM_TRANSPORT
	default 512
	help
	  This option sets the custom transport MTU.

config ROS2_MICROXRCEDDS_CLIENT_MAX_OUTPUT_BEST_EFFORT_STREAMS
	int "Max number of best-effort streams for output"
	default 1
	help
	  This option sets the maximum number of output best-effort
	  streams for session.

config ROS2_MICROXRCEDDS_CLIENT_MAX_INPUT_BEST_EFFORT_STREAMS
	int "Max number of best-effort streams for input"
	default 1
	help
	  This option sets the maximum number of input best-effort
	  streams for session.

config ROS2_MICROXRCEDDS_CLIENT_MAX_OUTPUT_RELIABLE_STREAMS
	int "Max number of reliable streams for output"
	default 1
	help
	  This option sets the maximum number of output reliable
	  streams for session.

config ROS2_MICROXRCEDDS_CLIENT_MAX_INPUT_RELIABLE_STREAMS
	int "Max number of reliable streams for input"
	default 1
	help
	  This option sets the maximum number of input reliable
	  streams for session.

config ROS2_MICROXRCEDDS_CLIENT_MAX_SESSION_CONNECTION_ATTEMPTS
	int "Max number of connection attempts for session"
	default 10
	help
	  This option sets the maximum number of connection attempts
	  allowed when establishing a session. The session-related
	  functions use this value to determine the number of retries
	  for connecting sessions.

config ROS2_MICROXRCEDDS_CLIENT_MIN_SESSION_CONNECTION_INTERVAL
	int "Session connection retry interval (milliseconds)"
	default 1000
	help
	  This option sets the minimum connection interval in
	  milliseconds when attempting to establish a session. It
	  determines the time delay between connection attempts.

config ROS2_MICROXRCEDDS_CLIENT_MIN_HEARTBEAT_TIME_INTERVAL
	int "Heartbeat interval (milliseconds)"
	default 100
	help
	  This option sets the minimum time interval, in milliseconds,
	  for sending heartbeats.

config ROS2_MICROXRCEDDS_CLIENT_HARD_LIVELINESS_CHECK
	bool "Enable hard liveliness check"
	default y
	help
	  This option enables hard liveliness check.

config ROS2_MICROXRCEDDS_CLIENT_HARD_LIVELINESS_CHECK_TIMEOUT
	int "Set the hard liveliness check interval in milliseconds."
	depends on ROS2_MICROXRCEDDS_CLIENT_HARD_LIVELINESS_CHECK
	default 10000
	help
	  This option enables hard liveliness check.

config ROS2_MICROXRCEDDS_CLIENT_TWEAK_XRCE_WRITE_LIMIT
	bool "Allow large XRCE WRITE DATA submessages"
	default y
	help
	  This feature uses a tweak to allow XRCE WRITE DATA
	  submessages grater than 64 kB.

endif

endmenu
```

## modules/rcl/Kconfig
```kconfig
# Copyright (c) 2022 Space Cubics, LLC.
# SPDX-License-Identifier: Apache-2.0

config RCL
	bool "rcl: ROS 2 Client Libraries"
	help
	  rcl: The ROS 2 Client Libraries
```

## modules/rcl_interfaces/Kconfig
```kconfig
# Copyright (c) 2022 Space Cubics, LLC.
# SPDX-License-Identifier: Apache-2.0

config RCL_INTERFACES
	bool "rcl_interfaces: ROS 2 Interface files"
	help
	  rcl_interfaces contains a set of packages that primarily
	  contain interface files (.msg and .srv) which are used both
	  to implement client library concepts and for testing.
```

## modules/rclc/Kconfig
```kconfig
# Copyright (c) 2022 Space Cubics, LLC.
# SPDX-License-Identifier: Apache-2.0

config RCLC
	bool "rclc: ROS 2 Client Libraries for C"
	help
	  rclc: The ROS 2 Client Libraries for C
```

## modules/rmw/Kconfig
```kconfig
# Copyright (c) 2022 Space Cubics, LLC.
# SPDX-License-Identifier: Apache-2.0

config RMW
	bool "ROS 2 Middleware"
	help
	  rmw: The ROS 2 Middleware
```

## modules/rmw_microxrcedds/Kconfig
```kconfig
menu "RMW Micro XRCE-DDS"

config ROS2_RMW_MICROXRCEDDS
	bool "RMW implementation using Micro XRCE-DDS"
	default y
	help
	  This option enables the ROS2 rmw_microxrcedds.

if ROS2_RMW_MICROXRCEDDS

choice ROS2_RMW_MICROXRCEDDS_TRANSPORT
	prompt "Transport to use"
	default ROS2_RMW_MICROXRCEDDS_TRANSPORT_CUSTOM
	help
	  Select Micro XRCE-DDS transport to use.

config ROS2_RMW_MICROXRCEDDS_TRANSPORT_UDP
	bool "UDP"

config ROS2_RMW_MICROXRCEDDS_TRANSPORT_TCP
	bool "TCP"

config ROS2_RMW_MICROXRCEDDS_TRANSPORT_SERIAL
	bool "Serial Port"

config ROS2_RMW_MICROXRCEDDS_TRANSPORT_CUSTOM
	bool "Custom Transport"

endchoice

choice ROS2_RMW_MICROXRCEDDS_IP_VERSION
	prompt "IP version to use"
	depends on ROS2_RMW_MICROXRCEDDS_TRANSPORT_UDP || ROS2_RMW_MICROXRCEDDS_TRANSPORT_TCP
	default ROS2_RMW_MICROXRCEDDS_IPV4
	help
	  Select Micro XRCE-DDS transport to use.

config ROS2_RMW_MICROXRCEDDS_IPV4
	bool "IPv4"

config ROS2_RMW_MICROXRCEDDS_IPV6
	bool "IPv6"

endchoice

choice ROS2_RMW_MICROXRCEDDS_CREATION_MODE
	prompt "Creation mode"
	default ROS2_RMW_MICROXRCEDDS_CREATION_MODE_BIN
	help
	  Select a set of functions for entity creations on the Agent.
	  See "Creation Mode: Client" in eProsima Micro XRCE-DDS
	  documentation.

	  Do not confused with CreationMode type in the spec, DDS
	  XRCE, version 1.0.

config ROS2_RMW_MICROXRCEDDS_CREATION_MODE_BIN
	bool "Binary"

config ROS2_RMW_MICROXRCEDDS_CREATION_MODE_REFS
	bool "References"

endchoice

config ROS2_RMW_MICROXRCEDDS_MAX_HISTORY
	int "Max number of histroy slots for RMW subscriptions"
	default 8
	help
	  This value sets the number of history slots available for
	  RMW subscriptions, requests and replies

config ROS2_RMW_MICROXRCEDDS_MAX_SESSIONS
	int "Max number of sessions"
	default 1
	help
	  This value sets the maximum number of Micro XRCE-DDS
	  sessions.

config ROS2_RMW_MICROXRCEDDS_MAX_NODES
	int "Max number of nodes"
	default 4
	help
	  This value sets the maximum number of nodes.

config ROS2_RMW_MICROXRCEDDS_MAX_PUBLISHERS
	int "Max number of publishers"
	default 4
	help
	  This value sets the maximum number of publishers for an
	  application.

config ROS2_RMW_MICROXRCEDDS_MAX_SUBSCRIPTIONS
	int "Max number of subscriptions"
	default 4
	help
	  This value sets the maximum number of subscriptions for an
	  application.

config ROS2_RMW_MICROXRCEDDS_MAX_SERVICES
	int "Max number of services"
	default 4
	help
	  This value sets the maximum number of services for an
	  application.

config ROS2_RMW_MICROXRCEDDS_MAX_CLIENTS
	int "Max number of clients"
	default 4
	help
	  This value sets the maximum number of clients for an
	  application.

config ROS2_RMW_MICROXRCEDDS_MAX_WAIT_SETS
	int "Max number of wait sets"
	default 4
	help
	  This value sets the maximum number of wait sets for an
	  application.

config ROS2_RMW_MICROXRCEDDS_MAX_GUARD_CONDITION
	int "Max number of guard conditions"
	default 4
	help
	  This value sets the maximum number of guard conditions for
	  an application.

config ROS2_RMW_MICROXRCEDDS_MAX_TOPICS
	int "Max number of topics"
	default -1
	help
	  This value sets the maximum number of topics for an
	  application.  If set to -1 ROS2_RMW_MICROXRCEDDS_MAX_TOPICS
	  ROS2_RMW_MICROXRCEDDS_MAX_PUBLISHERS +
	  ROS2_RMW_MICROXRCEDDS_MAX_SUBSCRIPTIONS +
	  ROS2_RMW_MICROXRCEDDS_MAX_NODES.

config ROS2_RMW_MICROXRCEDDS_NODE_NAME_MAX_LENGTH
	int "Max length of node name"
	default 60
	help
	  This value sets the maximum number of characters for a node
	  name.

config ROS2_RMW_MICROXRCEDDS_TOPIC_NAME_MAX_LENGTH
	int "Max length of topic name"
	default 60
	help
	  This value sets the maximum number of characters for a topic
	  name.

config ROS2_RMW_MICROXRCEDDS_TYPE_NAME_MAX_LENGTH
	int "Max length of type name"
	default 100
	help
	  This value sets the maximum number of characters for a type
	  name.

config ROS2_RMW_MICROXRCEDDS_REF_BUFFER_LENGTH
	int "Max length of reference buffer"
	default 100
	help
	  This value sets the maximum number of characters for a
	  reference buffer.

config ROS2_RMW_MICROXRCEDDS_PUBLISH_RELIABLE_TIMEOUT
	int "Default wait time in msec for publication in reliable mode"
	default 1000
	help
	  This value sets the default time to wait for a publication
	  in a reliable mode in milliseconds.

config ROS2_RMW_MICROXRCEDDS_ENTITY_CREATION_TIMEOUT
	int "Max wait time in msec for XRCE entity creation"
	default 1000
	help
	  This value sets the default maximum time to wait for an XRCE
	  entity creation in milliseconds.  If set to 0 best effort is
	  used.

config ROS2_RMW_MICROXRCEDDS_ENTITY_DESTRUCTION_TIMEOUT
	int "Max wait time in msec for XRCE entity destruction"
	default 1000
	help
	  This value sets the default maximum time to wait for an XRCE
	  entity destruction in milliseconds.  If set to 0 best effort is
	  used.

config ROS2_RMW_MICROXRCEDDS_STREAM_HISTORY_INPUT
	int
	default 4

config ROS2_RMW_MICROXRCEDDS_STREAM_HISTORY_OUTPUT
	int
	default 4

config ROS2_RMW_MICROXRCEDDS_ALLOW_DYNAMIC_ALLOCATIONS
	bool "Allow dynamic allocations"
	help
	  Enables increasing static pools with dynamic allocation when
	  needed.

endif

endmenu
```

## modules/ros2_tracing/Kconfig
```kconfig
# Copyright (c) 2022 Space Cubics, LLC.
# SPDX-License-Identifier: Apache-2.0

config ROS2_TRACING
	bool "ROS 2 Tracing"
	help
	  The ROS 2 Traceing
```

## modules/rosidl/Kconfig
```kconfig
# Copyright (c) 2022 Space Cubics, LLC.
# SPDX-License-Identifier: Apache-2.0

config ROSIDL
	bool "ROS 2 IDL"
	help
	  rosidl: The ROS 2 IDL
```

## modules/rosidl_typesupport/Kconfig
```kconfig
# Copyright (c) 2022 Space Cubics, LLC.
# SPDX-License-Identifier: Apache-2.0

config ROSIDL_TYPESUPPORT
	bool "ROS 2 IDL Type Support"
	help
	  rosidl_typesupport: The ROS 2 IDL Type Support
```

## modules/rosidl_typesupport_microxrcedds/Kconfig
```kconfig
# Copyright (c) 2022 Space Cubics, LLC.
# SPDX-License-Identifier: Apache-2.0

config ROSIDL_TYPESUPPORT_MICROXRCEDDS_C
	bool "ROSIDL type support for Micro XRCE-DDS"
	help
	  ROSIDL type support for Micro XRCE-DDS
```

## modules/unique_identifier_msgs/Kconfig
```kconfig
# Copyright (c) 2022 Space Cubics, LLC.
# SPDX-License-Identifier: Apache-2.0

config UNIQUE_IDENTIFIER_MSGS
	bool "unique_identifier_msgs: ROS 2 messages for Universally Unique Identifiers"
	help
	  ROS 2 messages for Universally Unique Identifiers.
```

## west.yml
```yaml
manifest:
  defaults:
    remote: micro-ros
    revision: main

  remotes:
    - name: ros2
      url-base: https://github.com/ros2
    - name: micro-ros
      url-base: https://github.com/micro-ROS
    - name: eprosima
      url-base: https://github.com/eprosima
    - name: yashi
      url-base: https://github.com/yashi

  projects:
    - name: common_interfaces
      remote: yashi #ros2
      revision: iron

    - name: microcdr
      repo-path: micro-cdr
      remote: yashi #eprosima
      revision: iron

    - name: microxrcedds-client
      repo-path: micro-xrce-dds-client
      remote: yashi #eprosima
      revision: iron

    - name: rcl
      remote: yashi #micro-ros
      revision: iron

    - name: rclc
      remote: yashi #ros2
      revision: iron

    - name: rcl_interfaces
      remote: yashi #ros2
      revision: iron

    - name: rcutils
      remote: yashi #micro-ros
      revision: iron

    - name: rmw
      remote: yashi #ros2
      revision: iron

    - name: rmw_microxrcedds
      remote: yashi #micro-ros
      revision: iron

    - name: ros2_tracing
      remote: yashi #ros2
      revision: iron

    - name: rosidl
      remote: yashi #ros2
      revision: iron

    - name: rosidl_typesupport
      remote: yashi #micro-ros
      revision: iron

    - name: rosidl_typesupport_microxrcedds
      remote: yashi #micro-ros
      revision: iron

    - name: unique_identifier_msgs
      remote: yashi #ros2
      revision: iron

    - name: rosidl_dynamic_typesupport
      remote: yashi #micro-ros
      revision: iron
```
